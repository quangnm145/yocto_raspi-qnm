## conf/distro/qnm_distro.conf
```bitbake
include conf/distro/poky.conf

# meta-qnm-raspi4 distro config
DISTRO = "qnm_distro"
DISTRO_NAME = "QNM Embedded Linux"
DISTRO_VERSION = "1.0"
DISTRO_CODENAME = "quangnm"
DISTRO_DESCRIPTION = "A custom Linux distro by QuangNM"
```

## conf/layer.conf
```bitbake
# We have a conf and classes directory, add to BBPATH
BBPATH .= ":${LAYERDIR}"

# We have recipes-* directories, add to BBFILES
BBFILES += "${LAYERDIR}/recipes-*/*/*.bb \
            ${LAYERDIR}/recipes-*/*/*.bbappend"

BBFILE_COLLECTIONS += "meta-qnm-raspi4"
BBFILE_PATTERN_meta-qnm-raspi4 = "^${LAYERDIR}/"
BBFILE_PRIORITY_meta-qnm-raspi4 = "10"

LAYERDEPENDS_meta-qnm-raspi4 = "core"
LAYERSERIES_COMPAT_meta-qnm-raspi4 = "scarthgap"
```
